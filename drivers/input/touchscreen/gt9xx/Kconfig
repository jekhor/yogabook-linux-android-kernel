## drivers/input/touchscreen/gt9xx/Kconfig
```kconfig
#
# Goodix touchscreen driver configuration
#
config TOUCHSCREEN_GT9XX
	tristate "Goodix touchscreen GT9XX"
	default n
	help
	  Say Y here if you have a Goodix touchscreen connected
	  to your system.

	  If unsure, say N.
```

## drivers/input/touchscreen/hideep/Kconfig
```kconfig
#
# Hideep touchscreen driver configuration
#
menuconfig TOUCHSCREEN_HIDEEP
	bool "Hideep touchscreen"
	default y
	help
	  Say Y here if you have a Hideep touchscreen connected
	  to your system.

	  If unsure, say N.
```

## drivers/input/touchscreen/ist771x/Kconfig
```kconfig
#
# Hideep touchscreen driver configuration
#
menuconfig TOUCHSCREEN_HIDEEP_IST771X
	bool "Hideep touchscreen IST771x"
	default n
	help
	  Say Y here if you have a Hideep touchscreen connected
	  to your system.

	  If unsure, say N.
```

## drivers/input/touchscreen/ist940e/Kconfig
```kconfig
#
# Hideep touchscreen driver configuration
#
menuconfig TOUCHSCREEN_HIDEEP_IST940E
	bool "Hideep touchscreen IST940E"
	default y
	help
	  Say Y here if you have a Hideep touchscreen connected
	  to your system.

	  If unsure, say N.
```

## drivers/input/touchscreen/smtpad/Kconfig
```kconfig
#
# lenovo virtual smart pad driver configuration
#
menuconfig LENOVO_SMART_PAD_SUPPORT
	bool "lenovo smart pad support"
	default y
	help
	  Say Y here if smart pad is supported

	  If unsure, say N.
```
